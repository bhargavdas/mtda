## meta-yocto/conf/layer.conf
```bitbake
# We have a conf and classes directory, add to BBPATH
BBPATH .= ":${LAYERDIR}"

# We have recipes-* directories, add to BBFILES
BBFILES += "${LAYERDIR}/recipes-*/*/*.bb \
            ${LAYERDIR}/recipes-*/*/*.bbappend"

BBFILE_COLLECTIONS += "meta-mtda-oe"
BBFILE_PATTERN_meta-mtda-oe = "^${LAYERDIR}/"
BBFILE_PRIORITY_meta-mtda-oe = "10"

LAYERDEPENDS_meta-mtda-oe = "core"
LAYERSERIES_COMPAT_meta-mtda-oe = "hardknott honister kirkstone"
DISTRO_FEATURES:append = " systemd "
VIRTUAL-RUNTIME_init_manager = "systemd"
```
